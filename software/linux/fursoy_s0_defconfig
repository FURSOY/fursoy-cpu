## software/linux/fursoy_s0_defconfig
```kconfig
# Fursoy Slice-0 Minimal Linux Kernel Configuration (Linux 6.6.50)
# Target Architecture: RV64IMA_Zicsr_Zifencei, Sv39, Single-Hart (Hart 0), SBI v0.2+, PLIC, Lite-16550A

CONFIG_64BIT=y
CONFIG_ARCH_RV64I=y
CONFIG_NONPORTABLE=y
# CONFIG_RISCV_ISA_C is not set
# CONFIG_FPU is not set
# CONFIG_RISCV_ISA_V is not set
# CONFIG_RISCV_ISA_ZBB is not set
# CONFIG_SMP is not set
CONFIG_NR_CPUS=1

CONFIG_MMU=y
CONFIG_PAGE_OFFSET=0xff60000000000000
CONFIG_CMODEL_MEDANY=y

CONFIG_RISCV_SBI=y
# CONFIG_RISCV_SBI_V01 is not set
CONFIG_RISCV_TIMER=y
CONFIG_SIFIVE_PLIC=y

CONFIG_OF=y
CONFIG_OF_EARLY_FLATTREE=y

CONFIG_PRINTK=y
CONFIG_PRINTK_TIME=y
CONFIG_EARLY_PRINTK=y

CONFIG_TTY=y
# CONFIG_VT is not set
# CONFIG_VGA_CONSOLE is not set
# CONFIG_LEGACY_PTYS is not set
CONFIG_SERIAL_EARLYCON=y
CONFIG_SERIAL_8250=y
CONFIG_SERIAL_8250_CONSOLE=y
CONFIG_SERIAL_OF_PLATFORM=y
CONFIG_SERIAL_8250_NR_UARTS=1
CONFIG_SERIAL_8250_RUNTIME_UARTS=1

CONFIG_BINFMT_ELF=y
CONFIG_BINFMT_SCRIPT=y
CONFIG_BLK_DEV_INITRD=y
CONFIG_INITRAMFS_SOURCE="/mnt/c/Projeler/fursoy-cpu/software/initramfs/initramfs_list"
CONFIG_INITRAMFS_ROOT_UID=0
CONFIG_INITRAMFS_ROOT_GID=0

CONFIG_NO_HZ_IDLE=y
CONFIG_HZ_100=y

CONFIG_DEVTMPFS=y
CONFIG_DEVTMPFS_MOUNT=y

CONFIG_CMDLINE="console=ttyS0,115200n8 earlycon=uart8250,mmio32,0x10000000 keep_bootcon loglevel=8 root=/dev/ram0 rw init=/init initcall_debug"
CONFIG_CMDLINE_EXTEND=y

# Disable unused subsystems for deterministic minimal build
# CONFIG_NET is not set
# CONFIG_PCI is not set
# CONFIG_MODULES is not set
# CONFIG_BLOCK is not set
# CONFIG_SUSPEND is not set
# CONFIG_HIBERNATION is not set
# CONFIG_PM is not set
# CONFIG_EFI is not set
# CONFIG_VIRTUALIZATION is not set
# CONFIG_DRM is not set
# CONFIG_SOUND is not set
# CONFIG_USB_SUPPORT is not set
# CONFIG_INPUT is not set
# CONFIG_HID is not set
CONFIG_CRYPTO_MANAGER_DISABLE_TESTS=y

CONFIG_EXPERT=y
CONFIG_EMBEDDED=y
CONFIG_SLUB=y
CONFIG_SLUB_TINY=y
```
